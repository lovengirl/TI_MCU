// @cliArgs --device MSPM0G3507 --package "LQFP-64(PM)"
const Board = scripting.addModule('/ti/driverlib/Board');
const SYSCTL = scripting.addModule('/ti/driverlib/SYSCTL');
SYSCTL.forceDefaultClkConfig=true;
SYSCTL.clockTreeEn=true;
system.clockTree['PLL_CLK1_DIV'].divideValue=4;
system.clockTree['PLL_CLK2X_DIV'].divideValue=4;
system.clockTree['PLL_PDIV'].divideValue=2;
system.clockTree['UDIV'].divideValue=2;
system.clockTree['PLL_QDIV'].multiplyValue=10;
system.clockTree['HSCLKMUX'].inputSelect='HSCLKMUX_SYSPLL2X';
SYSCTL.SYSPLL_CLK2XEn=true;
SYSCTL.HSCLKSource='SYSPLLCLK2X';
SYSCTL.validateClkStatus=true;
system.clockTree['MFPCLKGATE'].enable=true;
SYSCTL.MFPCLKEn=true;
const GPIO=scripting.addModule('/ti/driverlib/GPIO',{},false);
const pins=GPIO.addInstance();pins.$name='BOARD';pins.port='PORTB';
pins.associatedPins.create(17);
const names=['TX_A0','TX_A1','TX_A2','TX_A3','TX_A4','TX_EN','RX_A0','RX_A1','RX_A2','RX_A3','RX_A4','RX_EN','HOST_IRQ','HOST_RESET','STATUS','SCAN_MARK','RESERVED'];
for(let i=0;i<17;i++){
  let p=pins.associatedPins[i];p.$name=names[i];p.pin.$assign='PB'+i;
  p.assignedPin=''+i;p.initialValue='CLEARED';
}
pins.associatedPins[12].direction='INPUT';
pins.associatedPins[16].direction='INPUT';
const cs=GPIO.addInstance();cs.$name='HOST';cs.port='PORTA';
cs.associatedPins[0].$name='CS_N';cs.associatedPins[0].pin.$assign='PA8';
cs.associatedPins[0].assignedPin='8';cs.associatedPins[0].initialValue='SET';
const ADC=scripting.addModule('/ti/driverlib/ADC12',{},false).addInstance();
ADC.$name='RX_ADC';ADC.peripheral.$assign='ADC0';
ADC.adcMem0chansel='DL_ADC12_INPUT_CHAN_0';ADC.peripheral.adcPin0.$assign='PA27';
ADC.powerDownMode='DL_ADC12_POWER_DOWN_MODE_MANUAL';
ADC.repeatMode=true;ADC.trigSrc='DL_ADC12_TRIG_SRC_EVENT';ADC.subChanID=1;
ADC.adcMem0trig='DL_ADC12_TRIGGER_MODE_TRIGGER_NEXT';
ADC.sampleTime0='2 us';ADC.configureDMA=true;ADC.sampCnt=1;
ADC.enabledDMATriggers=['DL_ADC12_DMA_MEM0_RESULT_LOADED'];
ADC.DMA_CHANNEL.$name='ADC_DMA';ADC.DMA_CHANNEL.peripheral.$assign='DMA_CH0';
ADC.DMA_CHANNEL.addressMode='f2b';
ADC.DMA_CHANNEL.srcLength='HALF_WORD';ADC.DMA_CHANNEL.dstLength='HALF_WORD';
const DAC=scripting.addModule('/ti/driverlib/DAC12');
DAC.dacOutputPinEn=true;DAC.dacAmplifier='ON';DAC.dacPosVREF='VDDA';DAC.dacNegVREF='VSSA';
const TIMER=scripting.addModule('/ti/driverlib/TIMER',{},false);
const wait=TIMER.addInstance();wait.$name='WAIT_TIMER';wait.peripheral.$assign='TIMG0';
wait.timerClkSrc='BUSCLK';wait.timerClkDiv=1;wait.timerClkPrescale=40;
wait.timerPeriod='50 us';wait.interrupts=['ZERO'];
const sample=TIMER.addInstance();sample.$name='SAMPLE_TIMER';sample.peripheral.$assign='TIMG6';
sample.timerClkSrc='BUSCLK';sample.timerClkDiv=1;sample.timerClkPrescale=80;
sample.timerMode='PERIODIC';sample.timerPeriod='10 us';
sample.event1PublisherChannel=1;sample.event1ControllerInterruptEn=['ZERO_EVENT'];
const UART=scripting.addModule('/ti/driverlib/UART',{},false).addInstance();
UART.$name='DEBUG_UART';UART.peripheral.$assign='UART0';
UART.peripheral.txPin.$assign='PA10';UART.peripheral.rxPin.$assign='PA11';
UART.targetBaudRate=115200;UART.enabledInterrupts=['RX'];
const SPI=scripting.addModule('/ti/driverlib/SPI',{},false).addInstance();
SPI.$name='HOST_SPI';SPI.peripheral.$assign='SPI0';
SPI.frameFormat='MOTO3';
SPI.peripheral.sclkPin.$assign='PA12';
SPI.peripheral.misoPin.$assign='PA13';SPI.peripheral.mosiPin.$assign='PA14';
const WWDT=scripting.addModule('/ti/driverlib/WWDT',{},false).addInstance();
WWDT.$name='APP_WWDT';WWDT.peripheral.$assign='WWDT0';
WWDT.clockDivider='1';WWDT.periodCount='15';WWDT.window0ClosedPeriod='0';
